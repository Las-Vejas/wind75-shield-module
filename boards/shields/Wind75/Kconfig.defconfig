## boards/shields/Wind75/Kconfig.defconfig
```kconfig
if SHIELD_WIND75

# Name must be less than 16 characters long!
config ZMK_WIND75
    default "Wind75"

endif
```

## boards/shields/Wind75/Kconfig.shield
```kconfig
# No whitespace after the comma or in your keyboard name!
config SHIELD_WIND75
    def_bool $(shields_list_contains,wind75)
```

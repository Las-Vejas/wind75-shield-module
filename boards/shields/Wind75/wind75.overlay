/ {
    mcp23017: mcp23017@20 {
        compatible = "microchip,mcp23017";
        reg = <0x20>;
        label = "MCP23017";
        /* Add i2c-bus reference if needed, e.g., <&i2c1> */
        /* Add interrupt-gpios if used */
    };

    kscan0: kscan0 {
        compatible = "zmk,kscan-gpio-matrix";
        diode-direction = "col2row";
        wakeup-source;

        col-gpios = <&mcp23017 0 GPIO_ACTIVE_HIGH>, <&mcp23017 1 GPIO_ACTIVE_HIGH>, <&mcp23017 2 GPIO_ACTIVE_HIGH>;
        row-gpios = <&mcp23017 8 (GPIO_ACTIVE_HIGH | GPIO_PULL_DOWN)>, <&mcp23017 9 (GPIO_ACTIVE_HIGH | GPIO_PULL_DOWN)>, <&mcp23017 10 (GPIO_ACTIVE_HIGH | GPIO_PULL_DOWN)>;
    };
};